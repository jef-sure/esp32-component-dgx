## Kconfig
```kconfig
menu "DGX"

config DGX_ENABLE_SPI
    bool "Enable SPI transport backend"
    default n

config DGX_ENABLE_I2C
    bool "Enable I2C transport backend"
    default n

config DGX_ENABLE_P8
    bool "Enable 8-bit parallel transport backend"
    depends on SOC_LCD_I80_SUPPORTED
    default n

config DGX_ENABLE_DSI
    bool "Enable MIPI-DSI transport backend"
    depends on SOC_MIPI_DSI_SUPPORTED
    default n

config DGX_DSI_PRIVATE_DMA2D
    bool "Drive the 2D DMA of a DSI display through the private interface of IDF"
    depends on DGX_ENABLE_DSI && SOC_DMA2D_SUPPORTED
    default y
    help
        An escape hatch, not a setting. The bus moves large pieces of pixels
        by the 2D DMA of the chip: a part of a 16-bit virtual screen put to
        the display and, with two frame buffers, what one of them lacks of
        the other. The 2D DMA can exchange the two bytes of a pixel on the
        way, which only the private interface of IDF, esp_private/dma2d.h,
        gives; the bus also sets one field of a register directly, since IDF
        6.0.3 and later do not set it for 16-bit pixels. A private interface
        may change in any release of IDF.

        Leave it on. Turn it off only when an IDF no longer builds this code:
        the processor then moves the pieces, several times slower, and
        everything else works as before. The fill of a rectangle and the mix
        of two colors by the pixel processing accelerator use a public
        interface and do not depend on this option.

config DGX_DSI_INDEXED_BAND_KB
    int "Band of an 8-bit screen on its way to a DSI display, KB"
    depends on DGX_DSI_PRIVATE_DMA2D
    range 8 256
    default 64
    help
        An 8-bit screen put to a DSI display through a color table is made
        into rows of the panel by the processor, a band at a time, while the
        2D DMA moves the band before it into the frame buffer. There are two
        bands, in internal RAM, taken for the time of the call. Larger bands
        are faster: on a 1280x800 screen a full picture took 11.1 ms with 32
        KB, 9.9 with 64 and 9.3 with 100, and an overlay layer is mixed in
        faster too. Where internal RAM has no room for two bands of this
        size, smaller ones are tried, down to a quarter of it.

config DGX_ENABLE_SPI_ST7735
    bool "Enable ST7735 panel driver"
    depends on DGX_ENABLE_SPI || DGX_ENABLE_P8
    default n

config DGX_ENABLE_SPI_ST7789
    bool "Enable ST7789 panel driver"
    depends on DGX_ENABLE_SPI || DGX_ENABLE_P8
    default n

config DGX_ENABLE_SPI_GC9A01
    bool "Enable GC9A01 panel driver"
    depends on DGX_ENABLE_SPI || DGX_ENABLE_P8
    default n

config DGX_ENABLE_SPI_ILI_9341
    bool "Enable ILI9341 panel driver"
    depends on DGX_ENABLE_SPI || DGX_ENABLE_P8
    default n

config DGX_ENABLE_SSD1351
    bool "Enable SSD1351 panel driver"
    depends on DGX_ENABLE_SPI || DGX_ENABLE_P8
    default n

config DGX_ENABLE_JD9165
    bool "Enable JD9165 panel driver"
    depends on DGX_ENABLE_DSI
    default n

config DGX_ENABLE_JD9365
    bool "Enable JD9365 panel driver"
    depends on DGX_ENABLE_DSI
    default n

config DGX_ENABLE_SSD1306
    bool "Enable SSD1306 controller"
    depends on DGX_ENABLE_SPI || DGX_ENABLE_I2C
    select DGX_ENABLE_V_BW_SCREEN
    default n

config DGX_ENABLE_SSD1309
    bool "Enable SSD1309 controller"
    depends on DGX_ENABLE_SPI || DGX_ENABLE_I2C
    select DGX_ENABLE_V_BW_SCREEN
    default n

config DGX_ENABLE_SH1106
    bool "Enable SH1106 controller"
    depends on DGX_ENABLE_SPI || DGX_ENABLE_I2C
    select DGX_ENABLE_V_BW_SCREEN
    default n

config DGX_ENABLE_ST7565R
    bool "Enable ST7565R controller"
    depends on DGX_ENABLE_SPI
    select DGX_ENABLE_V_BW_SCREEN
    default n

config DGX_ENABLE_ST7920
    bool "Enable ST7920 controller"
    depends on DGX_ENABLE_SPI
    select DGX_ENABLE_VSCREEN
    default n

config DGX_ENABLE_V_BW_SCREEN
    bool "Enable monochrome virtual/back screen"
    default n

config DGX_ENABLE_VSCREEN
    bool "Enable RAM-backed virtual screen"
    default n

config DGX_ENABLE_VSCREEN_2H
    bool "Enable dual-head virtual compositor"
    depends on DGX_ENABLE_VSCREEN
    default n

config DGX_ENABLE_MORPH
    bool "Enable dot morphing framework (bit-matrix morphs, glow/sprite renderers)"
    select DGX_ENABLE_VSCREEN
    default n

config DGX_HW_FONT_IN_IRAM
    bool "Keep the code that lays out a handwritten text in IRAM"
    depends on IDF_TARGET_ESP32
    default n
    help
        The code of a program and the tables of a font are read from flash
        through one cache of two ways. Where a line of a font falls on a
        set that holds two lines of hot code already, every stroke waits
        for flash: the same text takes up to twice as long to go
        through and up to a third longer to draw, by where the linker has
        put the font, and that changes from build to build. Code in IRAM
        is not read through the cache.

        This takes 4.1 KB of IRAM for src/text/hw_font.c and the two functions
        of src/text/font.c that find a glyph. Going through the strokes of a
        text does not depend on the place of the font then, the drawing
        still does by half as much; see DGX_BEZIER_IN_IRAM.

        IRAM of an ESP32 is 128 KB and no part of the common heap, so it
        costs no heap. A program with Wi-Fi may have a few KB of it left:
        the linker says "IRAM0 segment data does not fit" when it is not
        enough. Measured on an ESP32 only, see docs/pen-en.md.

config DGX_BEZIER_IN_IRAM
    bool "Keep the code that draws Bezier curves by a pen in IRAM"
    depends on IDF_TARGET_ESP32
    default n
    help
        The same for src/draw/bezier.c, the hard pen and the soft one: 9.3 KB
        of IRAM. The time of drawing a handwritten text does not depend on
        the place of the font then, within 2%. With DGX_HW_FONT_IN_IRAM
        too, 13.3 KB in all, neither the drawing nor the going through
        does. See docs/pen-en.md.

endmenu
```

## examples/dsi_demo/main/Kconfig.projbuild
```kconfig
menu "DGX DSI demo"

choice EXAMPLE_BOARD
    prompt "Board"
    default EXAMPLE_BOARD_JC1060P470
    help
        The display, its lanes and its pins. The 10.1-inch board has a chip
        of revision 3: build it with sdkconfig.defaults.jc8012p4a1c, see
        the README.

config EXAMPLE_BOARD_JC1060P470
    bool "Guition JC1060P470: 7-inch 1024x600, JD9165"
    select DGX_ENABLE_JD9165

config EXAMPLE_BOARD_JC8012P4A1C
    bool "Guition JC8012P4A1C: 10.1-inch 800x1280, JD9365"
    select DGX_ENABLE_JD9365

endchoice

config EXAMPLE_LCD_COLOR_BITS
    int "Bits a pixel: 16 or 24"
    default 16
    help
        16 is RGB565: a frame buffer of 1.2 MB. 24 has 256 levels of every
        color and a frame buffer of 1.8 MB; the ramps of the demo show the
        difference.

config EXAMPLE_LCD_TWO_FRAMES
    bool "Two frame buffers: a picture is shown whole, without tearing"
    default n
    help
        With one frame buffer drawing goes into the frame the display is
        reading, and the moving bars of the demo are seen broken now and
        then. With two, a batch of drawing is shown whole at a frame
        boundary, for one more frame of PSRAM.

        Without this the numbers measured on the board decide: when
        dgx_dsi_advise() says that one frame buffer will run the display
        short of data, the display gets two anyway. See the README.

endmenu
```

## examples/hw_font_demo/sdkconfig.defaults
```kconfig
CONFIG_DGX_ENABLE_SPI=y
CONFIG_DGX_ENABLE_SPI_ILI_9341=y

# CYD: 4 MB flash
CONFIG_ESPTOOLPY_FLASHSIZE_4MB=y
CONFIG_ESP_DEFAULT_CPU_FREQ_MHZ_240=y
CONFIG_COMPILER_OPTIMIZATION_PERF=y
CONFIG_FREERTOS_HZ=1000
```

## examples/morph_demo/sdkconfig.defaults
```kconfig
CONFIG_DGX_ENABLE_SPI=y
CONFIG_DGX_ENABLE_SPI_ILI_9341=y
CONFIG_DGX_ENABLE_VSCREEN=y
CONFIG_DGX_ENABLE_MORPH=y
```

## examples/pixel_scale_demo/main/Kconfig.projbuild
```kconfig
menu "DGX pixel scale demo"

choice EXAMPLE_BOARD
    prompt "Board with an ESP32-P4"
    depends on IDF_TARGET_ESP32P4
    default EXAMPLE_BOARD_JC1060P470
    help
        The display, its lanes and its pins. The 10.1-inch board has a chip
        of revision 3: build it with sdkconfig.defaults.jc8012p4a1c, see
        the README. A build for an ESP32 is for a CYD.

config EXAMPLE_BOARD_JC1060P470
    bool "Guition JC1060P470: 7-inch 1024x600, JD9165"
    select DGX_ENABLE_JD9165

config EXAMPLE_BOARD_JC8012P4A1C
    bool "Guition JC8012P4A1C: 10.1-inch 800x1280, JD9365, turned to 1280x800"
    select DGX_ENABLE_JD9365

endchoice

endmenu
```
